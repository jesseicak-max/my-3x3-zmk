/ {
    kscan_0: kscan {
        compatible = "zmk,kscan-gpio-matrix";
        row-gpios = <&pro_micro 0 GPIO_ACTIVE_HIGH>,
                    <&pro_micro 1 GPIO_ACTIVE_HIGH>,
                    <&pro_micro 2 GPIO_ACTIVE_HIGH>;
        col-gpios = <&pro_micro 3 GPIO_ACTIVE_HIGH>,
                    <&pro_micro 4 GPIO_ACTIVE_HIGH>,
                    <&pro_micro 5 GPIO_ACTIVE_HIGH>;
    };

    chosen {
        zmk,kscan = &kscan_0;
        zmk,physical-layout = &matrix_3x3;
    };

    matrix_3x3: matrix_3x3 {
        compatible = "zmk,matrix-transform";
        rows = <3>;
        columns = <3>;
        map = <
            0 0
            0 1
            0 2
            1 0
            1 1
            1 2
            2 0
            2 1
            2 2
        >;
    };
};
