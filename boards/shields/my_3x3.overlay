/ {
	kscan0: kscan {
		compatible = "zmk,kscan-gpio-matrix";
		row-gp<&pro_micro 0 GPIO_ACTIVE_HIGH>,
					<&pro_micro 1 GPIO_ACTIVE_HIGH<&pro_micro 2 GPIO_ACTIVE_HIGH>;
		col-gp<&pro_micro 3 GPIO_ACTIVE_HIGH>,
					<&pro_micro 4 GPIO_ACTIVE_HIGH<&pro_micro 5 GPIO_ACTIVE_HIGH>;
		status = "okay";
	};

	matrix: matrix_transform {
		compatible = "zmk,matrix-transform";
		rows = <3>;
		<3>;<
			MT_ROW(0) MT_COL(0)
			MT_ROW(0) MT_COL(1)
			MT_ROW(0) MT_COL(2)

			MT_ROW(1) MT_COL(0)
			MT_ROW(1) MT_COL(1)
			MT_ROW(1) MT_COL(2)

			MT_ROW(2) MT_COL(0)
			MT_ROW(2) MT_COL(1)
			MT_ROW(2) MT_COL(2)
		>;
	};

	chosen {
		zmk,kscan = &kscan0;
		zmk,matrix-transform = &matrix;
	};
};
